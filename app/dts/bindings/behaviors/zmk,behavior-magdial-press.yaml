## app/dts/bindings/behaviors/zmk,behavior-magdial-press.yaml
```yaml
# Copyright (c) 2026 Electronic Materials Office Limited
# SPDX-License-Identifier: MIT

description: |
  Magdial press dispatch: single / double / triple tap and long press each
  tap their RPC-configured behavior binding. Bind at the dial's push-button
  keymap position.

compatible: "zmk,behavior-magdial-press"

include: zero_param.yaml

properties:
  tapping-term-ms:
    type: int
    default: 250
  hold-ms:
    type: int
    default: 500
  tap-ms:
    type: int
    default: 30
```

## app/dts/bindings/behaviors/zmk,behavior-magdial-rotate.yaml
```yaml
# Copyright (c) 2026 Electronic Materials Office Limited
# SPDX-License-Identifier: MIT

description: |
  Magdial rotate dispatch: taps the RPC-configured cw/ccw behavior binding
  once per detent trigger. Bind as the default layer's sensor-binding so
  higher layers' own sensor-bindings still preempt it.

compatible: "zmk,behavior-magdial-rotate"

properties:
  "#sensor-binding-cells":
    type: int
    required: true
    const: 0
  tap-ms:
    type: int
    default: 10
```
